/dts-v1/;
/plugin/;
/ {
	/* Raspberry Pi 3 */
	compatible = "brcm,bcm2837";

	fragment@0 {
		target = <&spidev0>;
		__overlay__ {
			status = "disabled";
		};
	};
	
	fragment@1 {
		target = <&spi0>;
		__overlay__ {
			status = "okay";
			#address-cells = <1>;
			#size-cells = <0>;

			w25q128jv: w25q128jv@0 {
				compatible = "mr,custom_w25q128jv";
				reg = <0x0>;
				spi-max-frequency = <8000>;
				spi-bits-per-word = <8>;
				status = "okay";
			};
		};
	};
};